// Libraries for ESP8266 WiFi and Firebase
#include <ESP8266WiFi.h>
#include <FirebaseESP8266.h>

// Libraries for OLED display
#include <Wire.h>
#include <Adafruit_GFX.h>
#include <Adafruit_SSD1306.h>

// WiFi credentials
#define wifi_name "chinna"
#define wifi_password "chinna123"

// Firebase credentials
#define firebase_url "https://home-c00e6-default-rtdb.firebaseio.com/"
#define firebase_secretkey "XAZcHm12lnOTCny3UkSIo4f1T67E1BmYBACekASW"

// OLED display settings
#define SCREEN_WIDTH 128
#define SCREEN_HEIGHT 64
#define OLED_RESET -1
Adafruit_SSD1306 display(SCREEN_WIDTH, SCREEN_HEIGHT, &Wire, OLED_RESET);

// Firebase data object
FirebaseData firebasedata;
int data;

// Bitmap for Image 1 (Dog)
const unsigned char dogBitmap[] PROGMEM = {
  
  0xff, 0xff, 0xff, 0xff, 0xff, 0xff, 0xff, 0xff, 0xff, 0xff, 0xff, 0xff, 0xff, 0xff, 0xff, 0xff, 
  0xff, 0xff, 0xff, 0xff, 0xff, 0xff, 0xff, 0xff, 0xff, 0xff, 0xff, 0xff, 0xff, 0xff, 0xff, 0xff, 
  0xff, 0xff, 0xff, 0xff, 0xff, 0xff, 0xff, 0xff, 0xff, 0xff, 0xff, 0xff, 0xff, 0xff, 0xff, 0xff, 
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  0xff, 0xff, 0xff, 0xff, 0xff, 0xff, 0xff, 0xff, 0xff, 0xff, 0xff, 0xff, 0xff, 0xff, 0xff, 0xff
};

// Bitmap for Image 2 (Cat)
const unsigned char DoorbellBitmap[] PROGMEM = {
 0x00, 0x00, 0x00, 0x00, 0x00, 0x00, 0x00, 0x00, 0x00, 0x00, 0x00, 0x00, 0x00, 0x00, 0x00, 0x00, 
	0x00, 0x3f, 0xff, 0xff, 0xff, 0xff, 0xff, 0xff, 0xff, 0x00, 0x00, 0x00, 0x00, 0x00, 0x00, 0x00, 
	0x03, 0xff, 0xff, 0xff, 0xff, 0xff, 0xff, 0xff, 0xff, 0xe0, 0x00, 0x00, 0x00, 0x00, 0x00, 0x00, 
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	0x00, 0x00, 0x00, 0x00, 0x00, 0x00, 0x00, 0x00, 0x00, 0x00, 0x00, 0x00, 0x00, 0x00, 0x00, 0x00
};
const unsigned char SmokeBitmap[] PROGMEM ={
	0xff, 0xff, 0xff, 0xff, 0xff, 0xff, 0xff, 0xff, 0xff, 0xff, 0xff, 0xff, 0xff, 0xff, 0xff, 0xff, 
	0xff, 0xff, 0xff, 0xff, 0xff, 0xff, 0xff, 0xff, 0xff, 0xff, 0xff, 0xff, 0xff, 0xff, 0xff, 0xff, 
	0xff, 0xff, 0xff, 0xff, 0xff, 0xff, 0xff, 0xff, 0xff, 0xff, 0xff, 0xff, 0xff, 0xff, 0xff, 0xff, 
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	0xff, 0xff, 0xff, 0xff, 0xff, 0xff, 0xff, 0xff, 0xff, 0xff, 0xff, 0xff, 0xff, 0xff, 0xff, 0xff
};

const unsigned char DooropenBitmap[] PROGMEM ={
	0xff, 0xff, 0xff, 0xff, 0xff, 0xff, 0xff, 0xff, 0xff, 0xff, 0xff, 0xff, 0xff, 0xff, 0xff, 0xff, 
	0xff, 0xff, 0xff, 0xff, 0xff, 0xff, 0xff, 0xff, 0xff, 0xff, 0xff, 0xff, 0xff, 0xff, 0xff, 0xff, 
	0xff, 0xff, 0xff, 0xff, 0xff, 0xff, 0xff, 0xff, 0xff, 0xff, 0xff, 0xff, 0xff, 0xff, 0xff, 0xff, 
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	0xff, 0xff, 0xff, 0xff, 0xff, 0xff, 0xff, 0xff, 0xff, 0xff, 0xff, 0xff, 0xff, 0xff, 0xff, 0xff
};
void setup() {
  Serial.begin(115200);
pinMode(2,OUTPUT);
  // Initialize OLED
  if (!display.begin(SSD1306_SWITCHCAPVCC, 0x3C)) {
    Serial.println(F("SSD1306 allocation failed"));
    for (;;);
  }

  display.clearDisplay();
  display.display();

  // Initialize WiFi
  WiFi.begin(wifi_name, wifi_password);
  Serial.print("Connecting to WiFi");
  while (WiFi.status() != WL_CONNECTED) {
    delay(500);
    Serial.print(".");
     display.clearDisplay();
  display.setTextSize(2);
  display.setTextColor(SSD1306_WHITE);
  display.setCursor(0, 20);
  display.print(".");
  display.display();
  }
  Serial.println("\nConnected to WiFi");
  
  // Initialize Firebase
  Firebase.begin(firebase_url, firebase_secretkey);
    display.clearDisplay();
  display.setTextSize(2);
  display.setTextColor(SSD1306_WHITE);
  display.setCursor(0, 20);
  display.print("CONNECTED TO CLOUD");
  display.display();
}

void loop() {
  // Fetch data from Firebase
  if (Firebase.get(firebasedata, "/sensor/state")) {
    data = firebasedata.intData();;
    
    // Show image based on value
    display.clearDisplay();
    
    if (data == 0) {
      // Display Dog Image
      display.drawBitmap(0, 0, dogBitmap, 128, 64, WHITE);
      digitalWrite(2,LOW);
    } else if (data == 1) {
      // Display Cat Image
      display.drawBitmap(0, 0, DoorbellBitmap, 128, 64, WHITE);
      digitalWrite(2,HIGH);
    }
     else if (data == 2) {
      // Display Cat Image
      display.drawBitmap(0, 0, DooropenBitmap, 128, 64, WHITE);
      digitalWrite(2,HIGH);
     }
    else if (data == 3) {
      // Display Cat Image
      display.drawBitmap(0, 0, SmokeBitmap, 128, 64, WHITE);
      digitalWrite(2,HIGH);
    }
    display.display();
  } else {
    Serial.println("Failed to get data from Firebase");
  }
  delay(1000); // Delay for 1 second
}
